## boards/geehy/g32r501_eval/Kconfig.g32r501_eval
```kconfig
# Copyright (c) 2025, Quincy.W <wangqyfm@foxmail.com>
# SPDX-License-Identifier: Apache-2.0

config BOARD_G32R501_EVAL
	select SOC_G32R501DVXT
```

## boards/geehy/g32r501_eval/board.yml
```yaml
board:
  name: g32r501_eval
  full_name: G32R501 EVAL
  vendor: geehy
  socs:
    - name: g32r501dvxt
```

## boards/geehy/g32r501_eval/g32r501_eval_g32r501dvxt_cpu0_defconfig
```kconfig
# g32r501_eval_g32r501dvxt_cpu0_defconfig

# Enable MPU
CONFIG_ARM_MPU=y

# Enable HW stack protection
CONFIG_HW_STACK_PROTECTION=y

CONFIG_CLOCK_CONTROL=y
CONFIG_GPIO=y
CONFIG_PINCTRL=y
CONFIG_SERIAL=y

CONFIG_XCLKOUT=y
CONFIG_XCLKOUT_DIV=3
CONFIG_XCLKOUT_SRC_SYSCLK=y

# console
CONFIG_CONSOLE=y
CONFIG_UART_CONSOLE=y
```

## boards/geehy/g32r502_eval/Kconfig.g32r502_eval
```kconfig
# Copyright (c) 2026, Quincy.W <wangqyfm@foxmail.com>
# SPDX-License-Identifier: Apache-2.0

config BOARD_G32R502_EVAL
	select SOC_G32R502MC
```

## boards/geehy/g32r502_eval/board.yml
```yaml
board:
  name: g32r502_eval
  full_name: G32R502 EVAL
  vendor: geehy
  socs:
    - name: g32r502mc
```

## boards/geehy/g32r502_eval/g32r502_eval_g32r502mc_defconfig
```kconfig
# g32r502_eval_g32r502mc_defconfig

# Enable MPU
CONFIG_ARM_MPU=y

# Enable HW stack protection
CONFIG_HW_STACK_PROTECTION=y

CONFIG_CLOCK_CONTROL=y
CONFIG_GPIO=y
CONFIG_PINCTRL=y
CONFIG_SERIAL=y

CONFIG_XCLKOUT=y
CONFIG_XCLKOUT_DIV=3
CONFIG_XCLKOUT_SRC_SYSCLK=y

# console
CONFIG_CONSOLE=y
CONFIG_UART_CONSOLE=y
```

## drivers/counter/Kconfig
```kconfig
# Copyright (c) 2026, Quincy.W <wangqyfm@foxmail.com>
# SPDX-License-Identifier: Apache-2.0

config COUNTER
	default y if DT_HAS_GEEHY_G32R5_TMR_ENABLED

config COUNTER_G32R5_TMR
	bool "G32R5 CPU timer counter driver"
	default y
	depends on COUNTER
	depends on DT_HAS_GEEHY_G32R5_TMR_ENABLED
	help
	  Enable the Zephyr counter driver for the G32R5 CPU timers
	  TMR0, TMR1 and TMR2.
```

## drivers/serial/Kconfig
```kconfig
# Copyright (c) 2025, Quincy.W <wangqyfm@foxmail.com>
# SPDX-License-Identifier: Apache-2.0

config UART_G32R5
	bool "G32R5 UART driver"
	default y
	depends on DT_HAS_GEEHY_G32R5_UART_ENABLED
	select SERIAL_HAS_DRIVER
	select SERIAL_SUPPORT_INTERRUPT
	help
	  Enable the G32R5 UART driver

if UART_G32R5

config UART_G32R5_FIFO
	bool "G32R5 UART 16-level hardware FIFO"
	help
	  Enable the TX and RX FIFOs. Poll and interrupt paths then use
	  FIFO status instead of the single-byte TXRDY and RXRDY flags.
	  Leave this off to keep the one-byte buffer.

config UART_G32R5_FIFO_RX_THRESHOLD
	int "RX FIFO interrupt level"
	depends on UART_G32R5_FIFO
	range 1 16
	default 1
	help
	  Interrupt when the RX FIFO holds at least this many words.
	  Level 0 is rejected by the hardware compare: the count is
	  always greater than or equal to zero, so the interrupt would
	  stay asserted. 1 interrupts on every received byte.

config UART_G32R5_FIFO_TX_THRESHOLD
	int "TX FIFO interrupt level"
	depends on UART_G32R5_FIFO
	range 0 15
	default 0
	help
	  Interrupt when the TX FIFO holds at most this many words.
	  0 interrupts once the FIFO is empty. 16 is not useful: the
	  FIFO never holds more than 16 words, so the interrupt would
	  stay asserted.

endif
```

## drivers/spi/Kconfig
```kconfig
# Copyright (c) 2026, Quincy.W <wangqyfm@foxmail.com>
# SPDX-License-Identifier: Apache-2.0

config SPI
	default y if DT_HAS_GEEHY_G32R5_SPI_ENABLED

config SPI_G32R5
	bool "G32R5 SPI driver"
	default y
	depends on SPI
	depends on DT_HAS_GEEHY_G32R5_SPI_ENABLED
	help
	  Enable the Zephyr SPI driver for the G32R5 SPI controllers.
	  G32R501 has SPIA and SPIB. G32R502 has SPIA only.
```

## dts/bindings/clock/geehy,g32r5-osc.yaml
```yaml
# Copyright (c) 2025, Quincy.W <wangqyfm@foxmail.com>
# SPDX-License-Identifier: Apache-2.0

description: G32R5 OSC Clock

compatible: "geehy,g32r5-osc"

include: [clock-controller.yaml, base.yaml]

properties:
  "#clock-cells":
    const: 0

  clocks:
    required: true
```

## dts/bindings/clock/geehy,g32r5-pll-clock.yaml
```yaml
# Copyright (c) 2025, Quincy.W <wangqyfm@foxmail.com>
# SPDX-License-Identifier: Apache-2.0

description: |
    G32R5 PLL Clock.
    
    fPLLSYSCLK = fOSCCLK * (IMULT + FMULT) / (ODIV * PLLSYSCLKDIV)

compatible: "geehy,g32r5-pll-clock"

include: [clock-controller.yaml, base.yaml]

properties:
  "#clock-cells":
    const: 0

  clocks:
    required: true

  imult:
    type: int
    required: true
    description: SYSPLL Integer Multiplier, Range is [1, 128]

  fmult:
    type: int
    required: true
    description: |
        SYSPLL Fractional Multiplier:
        - 0: 0
        - 1: 0.25
        - 2: 0.5
        - 3: 0.75
    enum:
      - 0
      - 1
      - 2
      - 3

  odiv:
    type: int
    required: true
    description: SYSPLL Output Clock Divider
    enum:
      - 1
      - 2
      - 3
      - 4
      - 5
      - 6
      - 7
      - 8

  pllsysclkdiv:
    type: int
    required: true
    description: SYSCLK Divide Select, Range is [1, 128]
```

## dts/bindings/clock/geehy,g32r5-sysclk.yaml
```yaml
# Copyright (c) 2025, Quincy.W <wangqyfm@foxmail.com>
# SPDX-License-Identifier: Apache-2.0

description: G32R5 Sysclk

compatible: "geehy,g32r5-sysclk"

include: [clock-controller.yaml, base.yaml]

properties:
  "#clock-cells":
    const: 0

  clocks:
    required: true

  clock-frequency:
    required: true
    type: int
    description: |
      default frequency in Hz for clock output
      
  apb-prescaler:
    type: int
    required: true
    enum:
      - 1
      - 2
      
  lsp-prescaler:
    type: int
    required: true
    enum:
      - 1
      - 2
      - 4
      - 6
      - 8
      - 10
      - 12
      - 14
```

## dts/bindings/clock/geehy,g32r5-xtal.yaml
```yaml
# Copyright (c) 2025, Quincy.W <wangqyfm@foxmail.com>
# SPDX-License-Identifier: Apache-2.0

description: G32R5 XTAL Clock

compatible: "geehy,g32r5-xtal"

include: [fixed-clock.yaml]

properties:
  xtal-osc-mode:
    type: string
    default: "Crystal"
    description: XTAL oscillator mode Configures
    enum:
      - "Crystal"
      - "Single-ended"

  clock-frequency:
    required: true
    type: int
    description: Frequency in Hz of xtal
```

## dts/bindings/counter/geehy,g32r5-tmr.yaml
```yaml
# Copyright (c) 2026, Quincy.W <wangqyfm@foxmail.com>
# SPDX-License-Identifier: Apache-2.0

description: |
  Geehy G32R5 CPU timer.

  The timer is a 32-bit down counter with one overflow interrupt and no
  compare channel, so the counter alarm and the top callback share that
  interrupt.

  TMR0 and TMR1 are clocked by SYSCLK. TMR2 selects its input with
  clocks and divides that input with clock-prescaler. prescaler is the
  timer's own divider, (TDDR + 1), and applies after the TMR2 mux.

compatible: "geehy,g32r5-tmr"

include: base.yaml

properties:
  reg:
    required: true

  interrupts:
    required: true

  clocks:
    description: |
      TMR2 input clock. Allowed phandles are &sysclk, &clk_intosc_1,
      &clk_intosc_2 and &clk_xtal. Omit it to select SYSCLK.
      TMR0 and TMR1 have no clock selector; leave this unset there.

  clock-prescaler:
    type: int
    enum:
      - 1
      - 2
      - 4
      - 8
      - 16
    description: |
      TMR2 clock-mux divider. The selected clocks input is divided by
      this value before it reaches the timer. TMR0 and TMR1 have no
      such divider; leave this unset there.

  prescaler:
    type: int
    default: 1
    description: |
      Timer divider applied as (TDDR + 1). The counter decrements once
      every prescaler clocks of its input. Allowed range is 1 to 65536.
```

## dts/bindings/gpio/geehy,g32r5-gpio-nexus.yaml
```yaml
# Copyright (c) 2026, Quincy.W <wangqyfm@foxmail.com>
# SPDX-License-Identifier: Apache-2.0

description: |
  G32R5 GPIO nexus. Specifiers use the chip's global GPIO number
  (GPIO0 is port A bit 0, GPIO32 is port B bit 0, GPIO224 is port H bit 0).
  The low 5 bits select the bit inside that port.

compatible: "geehy,g32r5-gpio-nexus"

include:
  - name: gpio-nexus.yaml
  - name: base.yaml

properties:
  "#gpio-cells":
    const: 2

gpio-cells:
  - pin
  - flags
```

## dts/bindings/gpio/geehy,g32r5-gpio.yaml
```yaml
# Copyright (c) 2025, Quincy.W <wangqyfm@foxmail.com>
# SPDX-License-Identifier: Apache-2.0

description: Geehy G32R5 GPIO controller

compatible: "geehy,g32r5-gpio"

include:
  - name: gpio-controller.yaml
  - name: base.yaml

properties:
  reg:
    required: true

  "#gpio-cells":
    const: 2

  ngpios:
    type: int
    default: 32

gpio-cells:
  - pin
  - flags
```

## dts/bindings/pinctrl/geehy,g32r5-pinctrl.yaml
```yaml
# Copyright (c) 2025, Quincy.W <wangqyfm@foxmail.com>
# SPDX-License-Identifier: Apache-2.0

description: |
  G32R5 Pin Controller

  Based on pincfg-node.yaml binding.
  Note: `bias-disable`  are default pin configurations.

compatible: "geehy,g32r5-pinctrl"

include: base.yaml

properties:
  reg:
    required: true


child-binding:
  description: |
    Base binding configuration for Geehy G32R5 MCUs

  include:
    - name: pincfg-node.yaml
      property-allowlist:
        - bias-disable
        - bias-pull-up
        - drive-push-pull
        - drive-open-drain
        - output-low
        - output-high

  properties:
    pinmux:
      required: true
      type: int
      description: |
        Integer array, represents gpio pin number and mux setting.
        These defines are calculated as: (function<<8 | pin_number<<0)
        With:
        - pin_number: The gpio pin number (0..255, including port H 224..245)
        - function: The function number, can be:
        * 0 : GPIO
        * 1 : Alternate Function 1
        * 2 : Alternate Function 2
        * 3 : Alternate Function 3
        * ...
```

## dts/bindings/serial/geehy,g32r5-uart.yaml
```yaml
# Copyright (c) 2025, Quincy.W <wangqyfm@foxmail.com>
# SPDX-License-Identifier: Apache-2.0

description: Geehy G32R5 UART controller

compatible: "geehy,g32r5-uart"

include: [uart-controller.yaml, reset-device.yaml, pinctrl-device.yaml]

properties:
  reg:
    required: true

  interrupts:
    required: true

  interrupt-names:
    type: string-array
    required: true
    description: |
      Must name both interrupt sources "rx" and "tx", in the order they
      appear in interrupts.

  pinctrl-0:
    type: phandles
    description: |
      Port pin configuration for RX & TX signals. 
      For example:
         pinctrl-0 = <&uarta_rx_gpio28 &uarta_tx_gpio29>;
    required: true
```

## dts/bindings/spi/geehy,g32r5-spi.yaml
```yaml
# Copyright (c) 2026, Quincy.W <wangqyfm@foxmail.com>
# SPDX-License-Identifier: Apache-2.0

description: |
  Geehy G32R5 SPI controller.

  The baud clock is LSPCLK. A transfer is legal only when the requested
  frequency is at most LSPCLK/4 and at least LSPCLK/128. Character
  length is 1 to 16 bits. Transmit data is left-justified in the 16-bit
  FIFO word. SPI_MODE_LOOP enables the internal SIMO-to-SOMI loopback,
  which is valid only while the controller is master.

compatible: "geehy,g32r5-spi"

include: [spi-controller.yaml, pinctrl-device.yaml]

properties:
  reg:
    required: true

  interrupts:
    required: true

  interrupt-names:
    type: string-array
    required: true
    description: |
      Must name both interrupt sources "rx" and "tx", in the order they
      appear in interrupts. The polling driver does not enable them.

  pinctrl-0:
    type: phandles
    description: |
      Pin configuration for CLK, SIMO and SOMI. STE is optional and is
      not used as a chip select; use cs-gpios for GPIO chip select.
      Omit pinctrl when the only user is internal loopback.
```

## soc/geehy/g32r5/Kconfig
```kconfig
# Copyright (c) 2025, Quincy.W <wangqyfm@foxmail.com>
# SPDX-License-Identifier: Apache-2.0

config SOC_FAMILY_G32R5
	bool
	select BUILD_OUTPUT_HEX
	select USE_G32R5_HAL
	select CPU_HAS_ARM_MPU
	select CPU_HAS_MPU
	select CPU_HAS_FPU
	select ARMV8_M_DSP
```

## soc/geehy/g32r5/Kconfig.soc
```kconfig
# Copyright (c) 2025, Quincy.W <wangqyfm@foxmail.com>
# SPDX-License-Identifier: Apache-2.0

config SOC_FAMILY_G32R5
	bool

config SOC_FAMILY
	default "g32r5" if SOC_FAMILY_G32R5

config SYS_CLOCK_HW_CYCLES_PER_SEC
	int
	default $(dt_node_int_prop_int,/soc/sysclk@50020800,clock-frequency) if SOC_SERIES_G32R501
	default $(dt_node_int_prop_int,/soc/sysclk@40013400,clock-frequency) if SOC_SERIES_G32R502

rsource "*/Kconfig.soc"

menuconfig XCLKOUT
	bool "XCLKOUT"
	help
	  Route an internal clock to the XCLKOUT pad (GPIO16 or GPIO18).
	  Available on both G32R501 and G32R502.

if XCLKOUT

config XCLKOUT_PIN
	int "XCLKOUT Pin"
	default 16
	help
		16 GPIO16
		18 GPIO18

config XCLKOUT_DIV
	int "XCLKOUTDIV"
	range 0 3
	default 3
	help
		Selects the div value
		0: /1
		1: /2
		2: /4
		3: /8

choice XCLKOUT_SRC
	prompt "XCLKOUT Source"
	default XCLKOUT_SRC_INTOSC1
	help
		XCLKOUTSEL

	config XCLKOUT_SRC_PLLSYSCLK
		bool "PLLSYSCLK"

	config XCLKOUT_SRC_PLLRAWCLK
		bool "PLLRAWCLK"

	config XCLKOUT_SRC_SYSCLK
		bool "SYSCLK"

	config XCLKOUT_SRC_APBCLK
		bool "APBCLK"

	config XCLKOUT_SRC_INTOSC1
		bool "INTOSC1"

	config XCLKOUT_SRC_INTOSC2
		bool "INTOSC2"

	config XCLKOUT_SRC_XTAL
		bool "XTAL"

endchoice

endif
```

## soc/geehy/g32r5/g32r501/Kconfig.soc
```kconfig
# Copyright (c) 2025, Quincy.W <wangqyfm@foxmail.com>
# SPDX-License-Identifier: Apache-2.0

config SOC_SERIES_G32R501
	bool "G32R501 Series MCU"
	select ARM
	select SOC_FAMILY_G32R5
	select CPU_HAS_FPU
	select CPU_CORTEX_M52
	select ARMV8_1_M_MVEI
	select ARMV8_1_M_MVEF

	select SOC_PREP_HOOK

	help
	  Enable support for Geehy G32R501 MCU series

config SOC_SERIES
	default "g32r501" if SOC_SERIES_G32R501

config SOC_G32R501DVXT
	bool "G32R501DVXT"
	select SOC_SERIES_G32R501

config SOC_G32R501DRXT
	bool "G32R501DRXT"
	select SOC_SERIES_G32R501

config SOC_G32R501DMXT
	bool "G32R501DMXT"
	select SOC_SERIES_G32R501

# G32R501DPYT7: 80-pin LQFP 10mm x 10mm. Same pinout as DMYT7
# (80-pin LQFP 12mm x 12mm); only the package body size differs.
config SOC_G32R501DPXT
	bool "G32R501DPXT"
	select SOC_SERIES_G32R501

config SOC_G32R501DNXU
	bool "G32R501DNXU"
	select SOC_SERIES_G32R501

config SOC_G32R501VXT
	bool "G32R501VXT"
	select SOC_SERIES_G32R501

config SOC_G32R501RXT
	bool "G32R501RXT"
	select SOC_SERIES_G32R501

config SOC_G32R501MXT
	bool "G32R501MXT"
	select SOC_SERIES_G32R501

config SOC_G32R501NXU
	bool "G32R501NXU"
	select SOC_SERIES_G32R501

config SOC
	default "g32r501dvxt" if SOC_G32R501DVXT
	default "g32r501drxt" if SOC_G32R501DRXT
	default "g32r501dmxt" if SOC_G32R501DMXT
	default "g32r501dpxt" if SOC_G32R501DPXT
	default "g32r501dnxu" if SOC_G32R501DNXU
	default "g32r501vxt" if SOC_G32R501VXT
	default "g32r501rxt" if SOC_G32R501RXT
	default "g32r501mxt" if SOC_G32R501MXT
	default "g32r501nxu" if SOC_G32R501NXU

config NUM_IRQS
	default 227
```
