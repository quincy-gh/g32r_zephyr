/*
 * Copyright (c) 2026, Quincy.W <wangqyfm@foxmail.com>
 *
 * SPDX-License-Identifier: Apache-2.0
 *
 * SPIA only. Internal loopback does not need pins. G32R502 has no SPIB.
 */

&spia {
	status = "okay";
};
