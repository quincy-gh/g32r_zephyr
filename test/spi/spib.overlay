/*
 * Copyright (c) 2026, Quincy.W <wangqyfm@foxmail.com>
 *
 * SPDX-License-Identifier: Apache-2.0
 *
 * G32R501 only. DTC_OVERLAY_FILE replaces app.overlay, so SPIA stays here.
 */

&spia {
	status = "okay";
};

&spib {
	status = "okay";
};
