/*
 * Copyright (c) 2025 Quincy.W <wangqyfm@foxmail.com>
 *
 * SPDX-License-Identifier: Apache-2.0
 *
 * G32R502 pinmux groups.
 * Pin number is bits 0..7 and the alternate function is bits 8..11.
 * GPIO mode (mux 0) is the reset default and is not a pinctrl group.
 * Signal names follow pin_map.h: UART for SCI, CANFD for MCAN.
 * Groups absent from pin_map.h follow datasheet V0.2.7 section 3.4.1.
 * A function already present on a pin is not repeated at another mux.
 * GPIO39 is omitted; datasheet V0.2.6 removed that pin.
 * AIO pins and GPIO244/GPIO245 have no alternate function.
 */

#include <dt-bindings/pinctrl/g32r5-pinctrl.h>

&pinctrl {
	/omit-if-no-ref/ pwm1_a_gpio0: pwm1_a_gpio0 {
		pinmux = < G32R5_PINMUX(0, 1) >;
	};
	/omit-if-no-ref/ cana_rx_gpio0: cana_rx_gpio0 {
		pinmux = < G32R5_PINMUX(0, 2) >;
	};
	/omit-if-no-ref/ outputxbar7_gpio0: outputxbar7_gpio0 {
		pinmux = < G32R5_PINMUX(0, 3) >;
	};
	/omit-if-no-ref/ uarta_rx_gpio0: uarta_rx_gpio0 {
		pinmux = < G32R5_PINMUX(0, 5) >;
	};
	/omit-if-no-ref/ i2ca_sda_gpio0: i2ca_sda_gpio0 {
		pinmux = < G32R5_PINMUX(0, 6) >;
	};
	/omit-if-no-ref/ spia_ste_gpio0: spia_ste_gpio0 {
		pinmux = < G32R5_PINMUX(0, 7) >;
	};
	/omit-if-no-ref/ canfd_rx_gpio0: canfd_rx_gpio0 {
		pinmux = < G32R5_PINMUX(0, 10) >;
	};
	/omit-if-no-ref/ qep1_index_gpio0: qep1_index_gpio0 {
		pinmux = < G32R5_PINMUX(0, 13) >;
	};
	/omit-if-no-ref/ pwm3_a_gpio0: pwm3_a_gpio0 {
		pinmux = < G32R5_PINMUX(0, 15) >;
	};
	/omit-if-no-ref/ pwm1_b_gpio1: pwm1_b_gpio1 {
		pinmux = < G32R5_PINMUX(1, 1) >;
	};
	/omit-if-no-ref/ uarta_tx_gpio1: uarta_tx_gpio1 {
		pinmux = < G32R5_PINMUX(1, 5) >;
	};
	/omit-if-no-ref/ i2ca_scl_gpio1: i2ca_scl_gpio1 {
		pinmux = < G32R5_PINMUX(1, 6) >;
	};
	/omit-if-no-ref/ spia_somi_gpio1: spia_somi_gpio1 {
		pinmux = < G32R5_PINMUX(1, 7) >;
	};
	/omit-if-no-ref/ qep1_strobe_gpio1: qep1_strobe_gpio1 {
		pinmux = < G32R5_PINMUX(1, 9) >;
	};
	/omit-if-no-ref/ canfd_tx_gpio1: canfd_tx_gpio1 {
		pinmux = < G32R5_PINMUX(1, 10) >;
	};
	/omit-if-no-ref/ pwm3_b_gpio1: pwm3_b_gpio1 {
		pinmux = < G32R5_PINMUX(1, 15) >;
	};
	/omit-if-no-ref/ pwm2_a_gpio2: pwm2_a_gpio2 {
		pinmux = < G32R5_PINMUX(2, 1) >;
	};
	/omit-if-no-ref/ outputxbar1_gpio2: outputxbar1_gpio2 {
		pinmux = < G32R5_PINMUX(2, 5) >;
	};
	/omit-if-no-ref/ pmbusa_sda_gpio2: pmbusa_sda_gpio2 {
		pinmux = < G32R5_PINMUX(2, 6) >;
	};
	/omit-if-no-ref/ spia_simo_gpio2: spia_simo_gpio2 {
		pinmux = < G32R5_PINMUX(2, 7) >;
	};
	/omit-if-no-ref/ uarta_tx_gpio2: uarta_tx_gpio2 {
		pinmux = < G32R5_PINMUX(2, 9) >;
	};
	/omit-if-no-ref/ i2cb_sda_gpio2: i2cb_sda_gpio2 {
		pinmux = < G32R5_PINMUX(2, 11) >;
	};
	/omit-if-no-ref/ cana_tx_gpio2: cana_tx_gpio2 {
		pinmux = < G32R5_PINMUX(2, 14) >;
	};
	/omit-if-no-ref/ pwm4_a_gpio2: pwm4_a_gpio2 {
		pinmux = < G32R5_PINMUX(2, 15) >;
	};
	/omit-if-no-ref/ pwm2_b_gpio3: pwm2_b_gpio3 {
		pinmux = < G32R5_PINMUX(3, 1) >;
	};
	/omit-if-no-ref/ outputxbar2_gpio3: outputxbar2_gpio3 {
		pinmux = < G32R5_PINMUX(3, 2) >;
	};
	/omit-if-no-ref/ pmbusa_scl_gpio3: pmbusa_scl_gpio3 {
		pinmux = < G32R5_PINMUX(3, 6) >;
	};
	/omit-if-no-ref/ spia_clk_gpio3: spia_clk_gpio3 {
		pinmux = < G32R5_PINMUX(3, 7) >;
	};
	/omit-if-no-ref/ uarta_rx_gpio3: uarta_rx_gpio3 {
		pinmux = < G32R5_PINMUX(3, 9) >;
	};
	/omit-if-no-ref/ i2cb_scl_gpio3: i2cb_scl_gpio3 {
		pinmux = < G32R5_PINMUX(3, 11) >;
	};
	/omit-if-no-ref/ cana_rx_gpio3: cana_rx_gpio3 {
		pinmux = < G32R5_PINMUX(3, 14) >;
	};
	/omit-if-no-ref/ pwm4_b_gpio3: pwm4_b_gpio3 {
		pinmux = < G32R5_PINMUX(3, 15) >;
	};
	/omit-if-no-ref/ pwm3_a_gpio4: pwm3_a_gpio4 {
		pinmux = < G32R5_PINMUX(4, 1) >;
	};
	/omit-if-no-ref/ i2ca_scl_gpio4: i2ca_scl_gpio4 {
		pinmux = < G32R5_PINMUX(4, 2) >;
	};
	/omit-if-no-ref/ canfd_tx_gpio4: canfd_tx_gpio4 {
		pinmux = < G32R5_PINMUX(4, 3) >;
	};
	/omit-if-no-ref/ outputxbar3_gpio4: outputxbar3_gpio4 {
		pinmux = < G32R5_PINMUX(4, 5) >;
	};
	/omit-if-no-ref/ cana_tx_gpio4: cana_tx_gpio4 {
		pinmux = < G32R5_PINMUX(4, 6) >;
	};
	/omit-if-no-ref/ spia_somi_gpio4: spia_somi_gpio4 {
		pinmux = < G32R5_PINMUX(4, 14) >;
	};
	/omit-if-no-ref/ pwm1_a_gpio4: pwm1_a_gpio4 {
		pinmux = < G32R5_PINMUX(4, 15) >;
	};
	/omit-if-no-ref/ pwm3_b_gpio5: pwm3_b_gpio5 {
		pinmux = < G32R5_PINMUX(5, 1) >;
	};
	/omit-if-no-ref/ i2ca_sda_gpio5: i2ca_sda_gpio5 {
		pinmux = < G32R5_PINMUX(5, 2) >;
	};
	/omit-if-no-ref/ outputxbar3_gpio5: outputxbar3_gpio5 {
		pinmux = < G32R5_PINMUX(5, 3) >;
	};
	/omit-if-no-ref/ canfd_rx_gpio5: canfd_rx_gpio5 {
		pinmux = < G32R5_PINMUX(5, 5) >;
	};
	/omit-if-no-ref/ cana_rx_gpio5: cana_rx_gpio5 {
		pinmux = < G32R5_PINMUX(5, 6) >;
	};
	/omit-if-no-ref/ spia_ste_gpio5: spia_ste_gpio5 {
		pinmux = < G32R5_PINMUX(5, 7) >;
	};
	/omit-if-no-ref/ uarta_rx_gpio5: uarta_rx_gpio5 {
		pinmux = < G32R5_PINMUX(5, 11) >;
	};
	/omit-if-no-ref/ pwm1_b_gpio5: pwm1_b_gpio5 {
		pinmux = < G32R5_PINMUX(5, 15) >;
	};
	/omit-if-no-ref/ pwm4_a_gpio6: pwm4_a_gpio6 {
		pinmux = < G32R5_PINMUX(6, 1) >;
	};
	/omit-if-no-ref/ outputxbar4_gpio6: outputxbar4_gpio6 {
		pinmux = < G32R5_PINMUX(6, 2) >;
	};
	/omit-if-no-ref/ syncout_gpio6: syncout_gpio6 {
		pinmux = < G32R5_PINMUX(6, 3) >;
	};
	/omit-if-no-ref/ qep1_a_gpio6: qep1_a_gpio6 {
		pinmux = < G32R5_PINMUX(6, 5) >;
	};
	/omit-if-no-ref/ pwm2_a_gpio6: pwm2_a_gpio6 {
		pinmux = < G32R5_PINMUX(6, 15) >;
	};
	/omit-if-no-ref/ pwm4_b_gpio7: pwm4_b_gpio7 {
		pinmux = < G32R5_PINMUX(7, 1) >;
	};
	/omit-if-no-ref/ pwm2_a_gpio7: pwm2_a_gpio7 {
		pinmux = < G32R5_PINMUX(7, 2) >;
	};
	/omit-if-no-ref/ outputxbar5_gpio7: outputxbar5_gpio7 {
		pinmux = < G32R5_PINMUX(7, 3) >;
	};
	/omit-if-no-ref/ qep1_b_gpio7: qep1_b_gpio7 {
		pinmux = < G32R5_PINMUX(7, 5) >;
	};
	/omit-if-no-ref/ spia_simo_gpio7: spia_simo_gpio7 {
		pinmux = < G32R5_PINMUX(7, 7) >;
	};
	/omit-if-no-ref/ uarta_tx_gpio7: uarta_tx_gpio7 {
		pinmux = < G32R5_PINMUX(7, 11) >;
	};
	/omit-if-no-ref/ cana_tx_gpio7: cana_tx_gpio7 {
		pinmux = < G32R5_PINMUX(7, 14) >;
	};
	/omit-if-no-ref/ pwm2_b_gpio7: pwm2_b_gpio7 {
		pinmux = < G32R5_PINMUX(7, 15) >;
	};
	/omit-if-no-ref/ pwm5_a_gpio8: pwm5_a_gpio8 {
		pinmux = < G32R5_PINMUX(8, 1) >;
	};
	/omit-if-no-ref/ adcsocao_gpio8: adcsocao_gpio8 {
		pinmux = < G32R5_PINMUX(8, 3) >;
	};
	/omit-if-no-ref/ qep1_strobe_gpio8: qep1_strobe_gpio8 {
		pinmux = < G32R5_PINMUX(8, 5) >;
	};
	/omit-if-no-ref/ uarta_tx_gpio8: uarta_tx_gpio8 {
		pinmux = < G32R5_PINMUX(8, 6) >;
	};
	/omit-if-no-ref/ spia_simo_gpio8: spia_simo_gpio8 {
		pinmux = < G32R5_PINMUX(8, 7) >;
	};
	/omit-if-no-ref/ i2ca_scl_gpio8: i2ca_scl_gpio8 {
		pinmux = < G32R5_PINMUX(8, 9) >;
	};
	/omit-if-no-ref/ pwm5_b_gpio9: pwm5_b_gpio9 {
		pinmux = < G32R5_PINMUX(9, 1) >;
	};
	/omit-if-no-ref/ uartb_tx_gpio9: uartb_tx_gpio9 {
		pinmux = < G32R5_PINMUX(9, 2) >;
	};
	/omit-if-no-ref/ outputxbar6_gpio9: outputxbar6_gpio9 {
		pinmux = < G32R5_PINMUX(9, 3) >;
	};
	/omit-if-no-ref/ qep1_index_gpio9: qep1_index_gpio9 {
		pinmux = < G32R5_PINMUX(9, 5) >;
	};
	/omit-if-no-ref/ uarta_rx_gpio9: uarta_rx_gpio9 {
		pinmux = < G32R5_PINMUX(9, 6) >;
	};
	/omit-if-no-ref/ spia_clk_gpio9: spia_clk_gpio9 {
		pinmux = < G32R5_PINMUX(9, 7) >;
	};
	/omit-if-no-ref/ i2cb_scl_gpio9: i2cb_scl_gpio9 {
		pinmux = < G32R5_PINMUX(9, 14) >;
	};
	/omit-if-no-ref/ pwm6_a_gpio10: pwm6_a_gpio10 {
		pinmux = < G32R5_PINMUX(10, 1) >;
	};
	/omit-if-no-ref/ adcsocbo_gpio10: adcsocbo_gpio10 {
		pinmux = < G32R5_PINMUX(10, 3) >;
	};
	/omit-if-no-ref/ qep1_a_gpio10: qep1_a_gpio10 {
		pinmux = < G32R5_PINMUX(10, 5) >;
	};
	/omit-if-no-ref/ uartb_tx_gpio10: uartb_tx_gpio10 {
		pinmux = < G32R5_PINMUX(10, 6) >;
	};
	/omit-if-no-ref/ spia_somi_gpio10: spia_somi_gpio10 {
		pinmux = < G32R5_PINMUX(10, 7) >;
	};
	/omit-if-no-ref/ i2ca_sda_gpio10: i2ca_sda_gpio10 {
		pinmux = < G32R5_PINMUX(10, 9) >;
	};
	/omit-if-no-ref/ pwm6_b_gpio11: pwm6_b_gpio11 {
		pinmux = < G32R5_PINMUX(11, 1) >;
	};
	/omit-if-no-ref/ cana_rx_gpio11: cana_rx_gpio11 {
		pinmux = < G32R5_PINMUX(11, 2) >;
	};
	/omit-if-no-ref/ outputxbar7_gpio11: outputxbar7_gpio11 {
		pinmux = < G32R5_PINMUX(11, 3) >;
	};
	/omit-if-no-ref/ qep1_b_gpio11: qep1_b_gpio11 {
		pinmux = < G32R5_PINMUX(11, 5) >;
	};
	/omit-if-no-ref/ uartb_rx_gpio11: uartb_rx_gpio11 {
		pinmux = < G32R5_PINMUX(11, 6) >;
	};
	/omit-if-no-ref/ spia_ste_gpio11: spia_ste_gpio11 {
		pinmux = < G32R5_PINMUX(11, 7) >;
	};
	/omit-if-no-ref/ spia_simo_gpio11: spia_simo_gpio11 {
		pinmux = < G32R5_PINMUX(11, 13) >;
	};
	/omit-if-no-ref/ pwm7_a_gpio12: pwm7_a_gpio12 {
		pinmux = < G32R5_PINMUX(12, 1) >;
	};
	/omit-if-no-ref/ canfd_rx_gpio12: canfd_rx_gpio12 {
		pinmux = < G32R5_PINMUX(12, 3) >;
	};
	/omit-if-no-ref/ qep1_strobe_gpio12: qep1_strobe_gpio12 {
		pinmux = < G32R5_PINMUX(12, 5) >;
	};
	/omit-if-no-ref/ uartb_tx_gpio12: uartb_tx_gpio12 {
		pinmux = < G32R5_PINMUX(12, 6) >;
	};
	/omit-if-no-ref/ pmbusa_ctl_gpio12: pmbusa_ctl_gpio12 {
		pinmux = < G32R5_PINMUX(12, 7) >;
	};
	/omit-if-no-ref/ spia_clk_gpio12: spia_clk_gpio12 {
		pinmux = < G32R5_PINMUX(12, 11) >;
	};
	/omit-if-no-ref/ cana_rx_gpio12: cana_rx_gpio12 {
		pinmux = < G32R5_PINMUX(12, 13) >;
	};
	/omit-if-no-ref/ traced2_gpio12: traced2_gpio12 {
		pinmux = < G32R5_PINMUX(12, 15) >;
	};
	/omit-if-no-ref/ pwm7_b_gpio13: pwm7_b_gpio13 {
		pinmux = < G32R5_PINMUX(13, 1) >;
	};
	/omit-if-no-ref/ canfd_tx_gpio13: canfd_tx_gpio13 {
		pinmux = < G32R5_PINMUX(13, 3) >;
	};
	/omit-if-no-ref/ qep1_index_gpio13: qep1_index_gpio13 {
		pinmux = < G32R5_PINMUX(13, 5) >;
	};
	/omit-if-no-ref/ uartb_rx_gpio13: uartb_rx_gpio13 {
		pinmux = < G32R5_PINMUX(13, 6) >;
	};
	/omit-if-no-ref/ pmbusa_alert_gpio13: pmbusa_alert_gpio13 {
		pinmux = < G32R5_PINMUX(13, 7) >;
	};
	/omit-if-no-ref/ spia_somi_gpio13: spia_somi_gpio13 {
		pinmux = < G32R5_PINMUX(13, 11) >;
	};
	/omit-if-no-ref/ cana_tx_gpio13: cana_tx_gpio13 {
		pinmux = < G32R5_PINMUX(13, 13) >;
	};
	/omit-if-no-ref/ traced3_gpio13: traced3_gpio13 {
		pinmux = < G32R5_PINMUX(13, 15) >;
	};
	/omit-if-no-ref/ uartb_tx_gpio14: uartb_tx_gpio14 {
		pinmux = < G32R5_PINMUX(14, 2) >;
	};
	/omit-if-no-ref/ i2cb_sda_gpio14: i2cb_sda_gpio14 {
		pinmux = < G32R5_PINMUX(14, 5) >;
	};
	/omit-if-no-ref/ outputxbar3_gpio14: outputxbar3_gpio14 {
		pinmux = < G32R5_PINMUX(14, 6) >;
	};
	/omit-if-no-ref/ pmbusa_sda_gpio14: pmbusa_sda_gpio14 {
		pinmux = < G32R5_PINMUX(14, 7) >;
	};
	/omit-if-no-ref/ pwm3_a_gpio14: pwm3_a_gpio14 {
		pinmux = < G32R5_PINMUX(14, 13) >;
	};
	/omit-if-no-ref/ uartb_rx_gpio15: uartb_rx_gpio15 {
		pinmux = < G32R5_PINMUX(15, 2) >;
	};
	/omit-if-no-ref/ i2cb_scl_gpio15: i2cb_scl_gpio15 {
		pinmux = < G32R5_PINMUX(15, 5) >;
	};
	/omit-if-no-ref/ outputxbar4_gpio15: outputxbar4_gpio15 {
		pinmux = < G32R5_PINMUX(15, 6) >;
	};
	/omit-if-no-ref/ pmbusa_scl_gpio15: pmbusa_scl_gpio15 {
		pinmux = < G32R5_PINMUX(15, 7) >;
	};
	/omit-if-no-ref/ pwm3_b_gpio15: pwm3_b_gpio15 {
		pinmux = < G32R5_PINMUX(15, 13) >;
	};
	/omit-if-no-ref/ spia_simo_gpio16: spia_simo_gpio16 {
		pinmux = < G32R5_PINMUX(16, 1) >;
	};
	/omit-if-no-ref/ outputxbar7_gpio16: outputxbar7_gpio16 {
		pinmux = < G32R5_PINMUX(16, 3) >;
	};
	/omit-if-no-ref/ pwm5_a_gpio16: pwm5_a_gpio16 {
		pinmux = < G32R5_PINMUX(16, 5) >;
	};
	/omit-if-no-ref/ uarta_tx_gpio16: uarta_tx_gpio16 {
		pinmux = < G32R5_PINMUX(16, 6) >;
	};
	/omit-if-no-ref/ qep1_strobe_gpio16: qep1_strobe_gpio16 {
		pinmux = < G32R5_PINMUX(16, 9) >;
	};
	/omit-if-no-ref/ pmbusa_scl_gpio16: pmbusa_scl_gpio16 {
		pinmux = < G32R5_PINMUX(16, 10) >;
	};
	/omit-if-no-ref/ xclkout_gpio16: xclkout_gpio16 {
		pinmux = < G32R5_PINMUX(16, 11) >;
	};
	/omit-if-no-ref/ traced0_gpio16: traced0_gpio16 {
		pinmux = < G32R5_PINMUX(16, 15) >;
	};
	/omit-if-no-ref/ spia_somi_gpio17: spia_somi_gpio17 {
		pinmux = < G32R5_PINMUX(17, 1) >;
	};
	/omit-if-no-ref/ outputxbar8_gpio17: outputxbar8_gpio17 {
		pinmux = < G32R5_PINMUX(17, 3) >;
	};
	/omit-if-no-ref/ pwm5_b_gpio17: pwm5_b_gpio17 {
		pinmux = < G32R5_PINMUX(17, 5) >;
	};
	/omit-if-no-ref/ uarta_rx_gpio17: uarta_rx_gpio17 {
		pinmux = < G32R5_PINMUX(17, 6) >;
	};
	/omit-if-no-ref/ qep1_index_gpio17: qep1_index_gpio17 {
		pinmux = < G32R5_PINMUX(17, 9) >;
	};
	/omit-if-no-ref/ pmbusa_sda_gpio17: pmbusa_sda_gpio17 {
		pinmux = < G32R5_PINMUX(17, 10) >;
	};
	/omit-if-no-ref/ cana_tx_gpio17: cana_tx_gpio17 {
		pinmux = < G32R5_PINMUX(17, 11) >;
	};
	/omit-if-no-ref/ pwm6_a_gpio17: pwm6_a_gpio17 {
		pinmux = < G32R5_PINMUX(17, 14) >;
	};
	/omit-if-no-ref/ trgio_gpio17: trgio_gpio17 {
		pinmux = < G32R5_PINMUX(17, 15) >;
	};
	/omit-if-no-ref/ spia_clk_gpio18: spia_clk_gpio18 {
		pinmux = < G32R5_PINMUX(18, 1) >;
	};
	/omit-if-no-ref/ uartb_tx_gpio18: uartb_tx_gpio18 {
		pinmux = < G32R5_PINMUX(18, 2) >;
	};
	/omit-if-no-ref/ cana_rx_gpio18: cana_rx_gpio18 {
		pinmux = < G32R5_PINMUX(18, 3) >;
	};
	/omit-if-no-ref/ pwm6_a_gpio18: pwm6_a_gpio18 {
		pinmux = < G32R5_PINMUX(18, 5) >;
	};
	/omit-if-no-ref/ i2ca_scl_gpio18: i2ca_scl_gpio18 {
		pinmux = < G32R5_PINMUX(18, 6) >;
	};
	/omit-if-no-ref/ pmbusa_ctl_gpio18: pmbusa_ctl_gpio18 {
		pinmux = < G32R5_PINMUX(18, 10) >;
	};
	/omit-if-no-ref/ xclkout_gpio18: xclkout_gpio18 {
		pinmux = < G32R5_PINMUX(18, 11) >;
	};
	/omit-if-no-ref/ spia_ste_gpio19: spia_ste_gpio19 {
		pinmux = < G32R5_PINMUX(19, 1) >;
	};
	/omit-if-no-ref/ uartb_rx_gpio19: uartb_rx_gpio19 {
		pinmux = < G32R5_PINMUX(19, 2) >;
	};
	/omit-if-no-ref/ cana_tx_gpio19: cana_tx_gpio19 {
		pinmux = < G32R5_PINMUX(19, 3) >;
	};
	/omit-if-no-ref/ pwm6_b_gpio19: pwm6_b_gpio19 {
		pinmux = < G32R5_PINMUX(19, 5) >;
	};
	/omit-if-no-ref/ i2ca_sda_gpio19: i2ca_sda_gpio19 {
		pinmux = < G32R5_PINMUX(19, 6) >;
	};
	/omit-if-no-ref/ pmbusa_alert_gpio19: pmbusa_alert_gpio19 {
		pinmux = < G32R5_PINMUX(19, 10) >;
	};
	/omit-if-no-ref/ qep1_a_gpio20: qep1_a_gpio20 {
		pinmux = < G32R5_PINMUX(20, 1) >;
	};
	/omit-if-no-ref/ cana_tx_gpio20: cana_tx_gpio20 {
		pinmux = < G32R5_PINMUX(20, 3) >;
	};
	/omit-if-no-ref/ spia_simo_gpio20: spia_simo_gpio20 {
		pinmux = < G32R5_PINMUX(20, 6) >;
	};
	/omit-if-no-ref/ canfd_tx_gpio20: canfd_tx_gpio20 {
		pinmux = < G32R5_PINMUX(20, 9) >;
	};
	/omit-if-no-ref/ i2ca_scl_gpio20: i2ca_scl_gpio20 {
		pinmux = < G32R5_PINMUX(20, 11) >;
	};
	/omit-if-no-ref/ uartc_tx_gpio20: uartc_tx_gpio20 {
		pinmux = < G32R5_PINMUX(20, 15) >;
	};
	/omit-if-no-ref/ qep1_b_gpio21: qep1_b_gpio21 {
		pinmux = < G32R5_PINMUX(21, 1) >;
	};
	/omit-if-no-ref/ cana_rx_gpio21: cana_rx_gpio21 {
		pinmux = < G32R5_PINMUX(21, 3) >;
	};
	/omit-if-no-ref/ spia_somi_gpio21: spia_somi_gpio21 {
		pinmux = < G32R5_PINMUX(21, 6) >;
	};
	/omit-if-no-ref/ canfd_rx_gpio21: canfd_rx_gpio21 {
		pinmux = < G32R5_PINMUX(21, 9) >;
	};
	/omit-if-no-ref/ i2ca_sda_gpio21: i2ca_sda_gpio21 {
		pinmux = < G32R5_PINMUX(21, 11) >;
	};
	/omit-if-no-ref/ uartc_rx_gpio21: uartc_rx_gpio21 {
		pinmux = < G32R5_PINMUX(21, 15) >;
	};
	/omit-if-no-ref/ qep1_strobe_gpio22: qep1_strobe_gpio22 {
		pinmux = < G32R5_PINMUX(22, 1) >;
	};
	/omit-if-no-ref/ uartb_tx_gpio22: uartb_tx_gpio22 {
		pinmux = < G32R5_PINMUX(22, 3) >;
	};
	/omit-if-no-ref/ lina_tx_gpio22: lina_tx_gpio22 {
		pinmux = < G32R5_PINMUX(22, 9) >;
	};
	/omit-if-no-ref/ pwm4_a_gpio22: pwm4_a_gpio22 {
		pinmux = < G32R5_PINMUX(22, 14) >;
	};
	/omit-if-no-ref/ qep1_index_gpio23: qep1_index_gpio23 {
		pinmux = < G32R5_PINMUX(23, 1) >;
	};
	/omit-if-no-ref/ uartb_rx_gpio23: uartb_rx_gpio23 {
		pinmux = < G32R5_PINMUX(23, 3) >;
	};
	/omit-if-no-ref/ lina_rx_gpio23: lina_rx_gpio23 {
		pinmux = < G32R5_PINMUX(23, 9) >;
	};
	/omit-if-no-ref/ pwm4_b_gpio23: pwm4_b_gpio23 {
		pinmux = < G32R5_PINMUX(23, 14) >;
	};
	/omit-if-no-ref/ outputxbar1_gpio24: outputxbar1_gpio24 {
		pinmux = < G32R5_PINMUX(24, 1) >;
	};
	/omit-if-no-ref/ spia_ste_gpio24: spia_ste_gpio24 {
		pinmux = < G32R5_PINMUX(24, 3) >;
	};
	/omit-if-no-ref/ pwm4_a_gpio24: pwm4_a_gpio24 {
		pinmux = < G32R5_PINMUX(24, 5) >;
	};
	/omit-if-no-ref/ spia_simo_gpio24: spia_simo_gpio24 {
		pinmux = < G32R5_PINMUX(24, 6) >;
	};
	/omit-if-no-ref/ pmbusa_scl_gpio24: pmbusa_scl_gpio24 {
		pinmux = < G32R5_PINMUX(24, 10) >;
	};
	/omit-if-no-ref/ uarta_tx_gpio24: uarta_tx_gpio24 {
		pinmux = < G32R5_PINMUX(24, 11) >;
	};
	/omit-if-no-ref/ errorsts_gpio24: errorsts_gpio24 {
		pinmux = < G32R5_PINMUX(24, 13) >;
	};
	/omit-if-no-ref/ outputxbar2_gpio25: outputxbar2_gpio25 {
		pinmux = < G32R5_PINMUX(25, 1) >;
	};
	/omit-if-no-ref/ qep1_a_gpio25: qep1_a_gpio25 {
		pinmux = < G32R5_PINMUX(25, 5) >;
	};
	/omit-if-no-ref/ pmbusa_sda_gpio25: pmbusa_sda_gpio25 {
		pinmux = < G32R5_PINMUX(25, 10) >;
	};
	/omit-if-no-ref/ uarta_rx_gpio25: uarta_rx_gpio25 {
		pinmux = < G32R5_PINMUX(25, 11) >;
	};
	/omit-if-no-ref/ outputxbar3_gpio26: outputxbar3_gpio26 {
		pinmux = < G32R5_PINMUX(26, 1) >;
	};
	/omit-if-no-ref/ pmbusa_ctl_gpio26: pmbusa_ctl_gpio26 {
		pinmux = < G32R5_PINMUX(26, 10) >;
	};
	/omit-if-no-ref/ i2ca_sda_gpio26: i2ca_sda_gpio26 {
		pinmux = < G32R5_PINMUX(26, 11) >;
	};
	/omit-if-no-ref/ outputxbar4_gpio27: outputxbar4_gpio27 {
		pinmux = < G32R5_PINMUX(27, 1) >;
	};
	/omit-if-no-ref/ pmbusa_alert_gpio27: pmbusa_alert_gpio27 {
		pinmux = < G32R5_PINMUX(27, 10) >;
	};
	/omit-if-no-ref/ i2ca_scl_gpio27: i2ca_scl_gpio27 {
		pinmux = < G32R5_PINMUX(27, 11) >;
	};
	/omit-if-no-ref/ uarta_rx_gpio28: uarta_rx_gpio28 {
		pinmux = < G32R5_PINMUX(28, 1) >;
	};
	/omit-if-no-ref/ pwm7_a_gpio28: pwm7_a_gpio28 {
		pinmux = < G32R5_PINMUX(28, 3) >;
	};
	/omit-if-no-ref/ outputxbar5_gpio28: outputxbar5_gpio28 {
		pinmux = < G32R5_PINMUX(28, 5) >;
	};
	/omit-if-no-ref/ qep1_a_gpio28: qep1_a_gpio28 {
		pinmux = < G32R5_PINMUX(28, 6) >;
	};
	/omit-if-no-ref/ lina_tx_gpio28: lina_tx_gpio28 {
		pinmux = < G32R5_PINMUX(28, 10) >;
	};
	/omit-if-no-ref/ spia_clk_gpio28: spia_clk_gpio28 {
		pinmux = < G32R5_PINMUX(28, 11) >;
	};
	/omit-if-no-ref/ errorsts_gpio28: errorsts_gpio28 {
		pinmux = < G32R5_PINMUX(28, 13) >;
	};
	/omit-if-no-ref/ i2cb_sda_gpio28: i2cb_sda_gpio28 {
		pinmux = < G32R5_PINMUX(28, 14) >;
	};
	/omit-if-no-ref/ traceclk_gpio28: traceclk_gpio28 {
		pinmux = < G32R5_PINMUX(28, 15) >;
	};
	/omit-if-no-ref/ uarta_tx_gpio29: uarta_tx_gpio29 {
		pinmux = < G32R5_PINMUX(29, 1) >;
	};
	/omit-if-no-ref/ pwm7_b_gpio29: pwm7_b_gpio29 {
		pinmux = < G32R5_PINMUX(29, 3) >;
	};
	/omit-if-no-ref/ outputxbar6_gpio29: outputxbar6_gpio29 {
		pinmux = < G32R5_PINMUX(29, 5) >;
	};
	/omit-if-no-ref/ qep1_b_gpio29: qep1_b_gpio29 {
		pinmux = < G32R5_PINMUX(29, 6) >;
	};
	/omit-if-no-ref/ lina_rx_gpio29: lina_rx_gpio29 {
		pinmux = < G32R5_PINMUX(29, 10) >;
	};
	/omit-if-no-ref/ spia_ste_gpio29: spia_ste_gpio29 {
		pinmux = < G32R5_PINMUX(29, 11) >;
	};
	/omit-if-no-ref/ errorsts_gpio29: errorsts_gpio29 {
		pinmux = < G32R5_PINMUX(29, 13) >;
	};
	/omit-if-no-ref/ i2cb_scl_gpio29: i2cb_scl_gpio29 {
		pinmux = < G32R5_PINMUX(29, 14) >;
	};
	/omit-if-no-ref/ traced2_gpio29: traced2_gpio29 {
		pinmux = < G32R5_PINMUX(29, 15) >;
	};
	/omit-if-no-ref/ cana_rx_gpio30: cana_rx_gpio30 {
		pinmux = < G32R5_PINMUX(30, 1) >;
	};
	/omit-if-no-ref/ outputxbar7_gpio30: outputxbar7_gpio30 {
		pinmux = < G32R5_PINMUX(30, 5) >;
	};
	/omit-if-no-ref/ qep1_strobe_gpio30: qep1_strobe_gpio30 {
		pinmux = < G32R5_PINMUX(30, 6) >;
	};
	/omit-if-no-ref/ canfd_rx_gpio30: canfd_rx_gpio30 {
		pinmux = < G32R5_PINMUX(30, 10) >;
	};
	/omit-if-no-ref/ pwm1_a_gpio30: pwm1_a_gpio30 {
		pinmux = < G32R5_PINMUX(30, 11) >;
	};
	/omit-if-no-ref/ traced1_gpio30: traced1_gpio30 {
		pinmux = < G32R5_PINMUX(30, 15) >;
	};
	/omit-if-no-ref/ cana_tx_gpio31: cana_tx_gpio31 {
		pinmux = < G32R5_PINMUX(31, 1) >;
	};
	/omit-if-no-ref/ outputxbar8_gpio31: outputxbar8_gpio31 {
		pinmux = < G32R5_PINMUX(31, 5) >;
	};
	/omit-if-no-ref/ qep1_index_gpio31: qep1_index_gpio31 {
		pinmux = < G32R5_PINMUX(31, 6) >;
	};
	/omit-if-no-ref/ canfd_tx_gpio31: canfd_tx_gpio31 {
		pinmux = < G32R5_PINMUX(31, 10) >;
	};
	/omit-if-no-ref/ pwm1_b_gpio31: pwm1_b_gpio31 {
		pinmux = < G32R5_PINMUX(31, 11) >;
	};
	/omit-if-no-ref/ traceclk_gpio31: traceclk_gpio31 {
		pinmux = < G32R5_PINMUX(31, 15) >;
	};
	/omit-if-no-ref/ i2ca_sda_gpio32: i2ca_sda_gpio32 {
		pinmux = < G32R5_PINMUX(32, 1) >;
	};
	/omit-if-no-ref/ qep1_index_gpio32: qep1_index_gpio32 {
		pinmux = < G32R5_PINMUX(32, 2) >;
	};
	/omit-if-no-ref/ spia_clk_gpio32: spia_clk_gpio32 {
		pinmux = < G32R5_PINMUX(32, 3) >;
	};
	/omit-if-no-ref/ pwm4_b_gpio32: pwm4_b_gpio32 {
		pinmux = < G32R5_PINMUX(32, 5) >;
	};
	/omit-if-no-ref/ lina_tx_gpio32: lina_tx_gpio32 {
		pinmux = < G32R5_PINMUX(32, 6) >;
	};
	/omit-if-no-ref/ cana_tx_gpio32: cana_tx_gpio32 {
		pinmux = < G32R5_PINMUX(32, 10) >;
	};
	/omit-if-no-ref/ pmbusa_sda_gpio32: pmbusa_sda_gpio32 {
		pinmux = < G32R5_PINMUX(32, 11) >;
	};
	/omit-if-no-ref/ adcsocbo_gpio32: adcsocbo_gpio32 {
		pinmux = < G32R5_PINMUX(32, 13) >;
	};
	/omit-if-no-ref/ trgio_gpio32: trgio_gpio32 {
		pinmux = < G32R5_PINMUX(32, 15) >;
	};
	/omit-if-no-ref/ i2ca_scl_gpio33: i2ca_scl_gpio33 {
		pinmux = < G32R5_PINMUX(33, 1) >;
	};
	/omit-if-no-ref/ outputxbar4_gpio33: outputxbar4_gpio33 {
		pinmux = < G32R5_PINMUX(33, 5) >;
	};
	/omit-if-no-ref/ lina_rx_gpio33: lina_rx_gpio33 {
		pinmux = < G32R5_PINMUX(33, 6) >;
	};
	/omit-if-no-ref/ cana_rx_gpio33: cana_rx_gpio33 {
		pinmux = < G32R5_PINMUX(33, 10) >;
	};
	/omit-if-no-ref/ adcsocao_gpio33: adcsocao_gpio33 {
		pinmux = < G32R5_PINMUX(33, 13) >;
	};
	/omit-if-no-ref/ traced1_gpio33: traced1_gpio33 {
		pinmux = < G32R5_PINMUX(33, 15) >;
	};
	/omit-if-no-ref/ outputxbar1_gpio34: outputxbar1_gpio34 {
		pinmux = < G32R5_PINMUX(34, 1) >;
	};
	/omit-if-no-ref/ pmbusa_sda_gpio34: pmbusa_sda_gpio34 {
		pinmux = < G32R5_PINMUX(34, 6) >;
	};
	/omit-if-no-ref/ i2cb_sda_gpio34: i2cb_sda_gpio34 {
		pinmux = < G32R5_PINMUX(34, 14) >;
	};
	/omit-if-no-ref/ traced3_gpio34: traced3_gpio34 {
		pinmux = < G32R5_PINMUX(34, 15) >;
	};
	/omit-if-no-ref/ uarta_rx_gpio35: uarta_rx_gpio35 {
		pinmux = < G32R5_PINMUX(35, 1) >;
	};
	/omit-if-no-ref/ spia_somi_gpio35: spia_somi_gpio35 {
		pinmux = < G32R5_PINMUX(35, 2) >;
	};
	/omit-if-no-ref/ i2ca_sda_gpio35: i2ca_sda_gpio35 {
		pinmux = < G32R5_PINMUX(35, 3) >;
	};
	/omit-if-no-ref/ cana_rx_gpio35: cana_rx_gpio35 {
		pinmux = < G32R5_PINMUX(35, 5) >;
	};
	/omit-if-no-ref/ pmbusa_scl_gpio35: pmbusa_scl_gpio35 {
		pinmux = < G32R5_PINMUX(35, 6) >;
	};
	/omit-if-no-ref/ lina_rx_gpio35: lina_rx_gpio35 {
		pinmux = < G32R5_PINMUX(35, 7) >;
	};
	/omit-if-no-ref/ qep1_a_gpio35: qep1_a_gpio35 {
		pinmux = < G32R5_PINMUX(35, 9) >;
	};
	/omit-if-no-ref/ pmbusa_ctl_gpio35: pmbusa_ctl_gpio35 {
		pinmux = < G32R5_PINMUX(35, 10) >;
	};
	/omit-if-no-ref/ pwm5_b_gpio35: pwm5_b_gpio35 {
		pinmux = < G32R5_PINMUX(35, 11) >;
	};
	/omit-if-no-ref/ tdi_gpio35: tdi_gpio35 {
		pinmux = < G32R5_PINMUX(35, 15) >;
	};
	/omit-if-no-ref/ outputxbar2_gpio37: outputxbar2_gpio37 {
		pinmux = < G32R5_PINMUX(37, 1) >;
	};
	/omit-if-no-ref/ spia_ste_gpio37: spia_ste_gpio37 {
		pinmux = < G32R5_PINMUX(37, 2) >;
	};
	/omit-if-no-ref/ i2ca_scl_gpio37: i2ca_scl_gpio37 {
		pinmux = < G32R5_PINMUX(37, 3) >;
	};
	/omit-if-no-ref/ uarta_tx_gpio37: uarta_tx_gpio37 {
		pinmux = < G32R5_PINMUX(37, 5) >;
	};
	/omit-if-no-ref/ cana_tx_gpio37: cana_tx_gpio37 {
		pinmux = < G32R5_PINMUX(37, 6) >;
	};
	/omit-if-no-ref/ lina_tx_gpio37: lina_tx_gpio37 {
		pinmux = < G32R5_PINMUX(37, 7) >;
	};
	/omit-if-no-ref/ qep1_b_gpio37: qep1_b_gpio37 {
		pinmux = < G32R5_PINMUX(37, 9) >;
	};
	/omit-if-no-ref/ pmbusa_alert_gpio37: pmbusa_alert_gpio37 {
		pinmux = < G32R5_PINMUX(37, 10) >;
	};
	/omit-if-no-ref/ pwm5_a_gpio37: pwm5_a_gpio37 {
		pinmux = < G32R5_PINMUX(37, 11) >;
	};
	/omit-if-no-ref/ tdo_gpio37: tdo_gpio37 {
		pinmux = < G32R5_PINMUX(37, 15) >;
	};
	/omit-if-no-ref/ pwm2_b_gpio40: pwm2_b_gpio40 {
		pinmux = < G32R5_PINMUX(40, 5) >;
	};
	/omit-if-no-ref/ pmbusa_sda_gpio40: pmbusa_sda_gpio40 {
		pinmux = < G32R5_PINMUX(40, 6) >;
	};
	/omit-if-no-ref/ uartb_tx_gpio40: uartb_tx_gpio40 {
		pinmux = < G32R5_PINMUX(40, 9) >;
	};
	/omit-if-no-ref/ qep1_a_gpio40: qep1_a_gpio40 {
		pinmux = < G32R5_PINMUX(40, 10) >;
	};
	/omit-if-no-ref/ pwm7_a_gpio41: pwm7_a_gpio41 {
		pinmux = < G32R5_PINMUX(41, 1) >;
	};
	/omit-if-no-ref/ pwm2_a_gpio41: pwm2_a_gpio41 {
		pinmux = < G32R5_PINMUX(41, 5) >;
	};
	/omit-if-no-ref/ pmbusa_scl_gpio41: pmbusa_scl_gpio41 {
		pinmux = < G32R5_PINMUX(41, 6) >;
	};
	/omit-if-no-ref/ uartb_rx_gpio41: uartb_rx_gpio41 {
		pinmux = < G32R5_PINMUX(41, 9) >;
	};
	/omit-if-no-ref/ qep1_b_gpio41: qep1_b_gpio41 {
		pinmux = < G32R5_PINMUX(41, 10) >;
	};
	/omit-if-no-ref/ lina_rx_gpio42: lina_rx_gpio42 {
		pinmux = < G32R5_PINMUX(42, 2) >;
	};
	/omit-if-no-ref/ outputxbar5_gpio42: outputxbar5_gpio42 {
		pinmux = < G32R5_PINMUX(42, 3) >;
	};
	/omit-if-no-ref/ pmbusa_ctl_gpio42: pmbusa_ctl_gpio42 {
		pinmux = < G32R5_PINMUX(42, 5) >;
	};
	/omit-if-no-ref/ i2ca_sda_gpio42: i2ca_sda_gpio42 {
		pinmux = < G32R5_PINMUX(42, 6) >;
	};
	/omit-if-no-ref/ uartc_rx_gpio42: uartc_rx_gpio42 {
		pinmux = < G32R5_PINMUX(42, 7) >;
	};
	/omit-if-no-ref/ qep1_strobe_gpio42: qep1_strobe_gpio42 {
		pinmux = < G32R5_PINMUX(42, 10) >;
	};
	/omit-if-no-ref/ outputxbar6_gpio43: outputxbar6_gpio43 {
		pinmux = < G32R5_PINMUX(43, 3) >;
	};
	/omit-if-no-ref/ pmbusa_alert_gpio43: pmbusa_alert_gpio43 {
		pinmux = < G32R5_PINMUX(43, 5) >;
	};
	/omit-if-no-ref/ i2ca_scl_gpio43: i2ca_scl_gpio43 {
		pinmux = < G32R5_PINMUX(43, 6) >;
	};
	/omit-if-no-ref/ uartc_tx_gpio43: uartc_tx_gpio43 {
		pinmux = < G32R5_PINMUX(43, 7) >;
	};
	/omit-if-no-ref/ qep1_index_gpio43: qep1_index_gpio43 {
		pinmux = < G32R5_PINMUX(43, 10) >;
	};
	/omit-if-no-ref/ outputxbar7_gpio44: outputxbar7_gpio44 {
		pinmux = < G32R5_PINMUX(44, 3) >;
	};
	/omit-if-no-ref/ qep1_a_gpio44: qep1_a_gpio44 {
		pinmux = < G32R5_PINMUX(44, 5) >;
	};
	/omit-if-no-ref/ pmbusa_sda_gpio44: pmbusa_sda_gpio44 {
		pinmux = < G32R5_PINMUX(44, 6) >;
	};
	/omit-if-no-ref/ pmbusa_ctl_gpio44: pmbusa_ctl_gpio44 {
		pinmux = < G32R5_PINMUX(44, 9) >;
	};
	/omit-if-no-ref/ outputxbar8_gpio45: outputxbar8_gpio45 {
		pinmux = < G32R5_PINMUX(45, 3) >;
	};
	/omit-if-no-ref/ pmbusa_alert_gpio45: pmbusa_alert_gpio45 {
		pinmux = < G32R5_PINMUX(45, 9) >;
	};
	/omit-if-no-ref/ lina_tx_gpio46: lina_tx_gpio46 {
		pinmux = < G32R5_PINMUX(46, 3) >;
	};
	/omit-if-no-ref/ canfd_tx_gpio46: canfd_tx_gpio46 {
		pinmux = < G32R5_PINMUX(46, 5) >;
	};
	/omit-if-no-ref/ pmbusa_sda_gpio46: pmbusa_sda_gpio46 {
		pinmux = < G32R5_PINMUX(46, 9) >;
	};
	/omit-if-no-ref/ outputxbar3_gpio48: outputxbar3_gpio48 {
		pinmux = < G32R5_PINMUX(48, 1) >;
	};
	/omit-if-no-ref/ cana_tx_gpio48: cana_tx_gpio48 {
		pinmux = < G32R5_PINMUX(48, 3) >;
	};
	/omit-if-no-ref/ canfd_tx_gpio48: canfd_tx_gpio48 {
		pinmux = < G32R5_PINMUX(48, 5) >;
	};
	/omit-if-no-ref/ uarta_tx_gpio48: uarta_tx_gpio48 {
		pinmux = < G32R5_PINMUX(48, 6) >;
	};
	/omit-if-no-ref/ pmbusa_sda_gpio48: pmbusa_sda_gpio48 {
		pinmux = < G32R5_PINMUX(48, 9) >;
	};
	/omit-if-no-ref/ outputxbar4_gpio49: outputxbar4_gpio49 {
		pinmux = < G32R5_PINMUX(49, 1) >;
	};
	/omit-if-no-ref/ cana_rx_gpio49: cana_rx_gpio49 {
		pinmux = < G32R5_PINMUX(49, 3) >;
	};
	/omit-if-no-ref/ canfd_rx_gpio49: canfd_rx_gpio49 {
		pinmux = < G32R5_PINMUX(49, 5) >;
	};
	/omit-if-no-ref/ uarta_rx_gpio49: uarta_rx_gpio49 {
		pinmux = < G32R5_PINMUX(49, 6) >;
	};
	/omit-if-no-ref/ lina_rx_gpio49: lina_rx_gpio49 {
		pinmux = < G32R5_PINMUX(49, 9) >;
	};
	/omit-if-no-ref/ outputxbar3_gpio224: outputxbar3_gpio224 {
		pinmux = < G32R5_PINMUX(224, 5) >;
	};
	/omit-if-no-ref/ spia_simo_gpio224: spia_simo_gpio224 {
		pinmux = < G32R5_PINMUX(224, 6) >;
	};
	/omit-if-no-ref/ pwm1_a_gpio224: pwm1_a_gpio224 {
		pinmux = < G32R5_PINMUX(224, 9) >;
	};
	/omit-if-no-ref/ cana_tx_gpio224: cana_tx_gpio224 {
		pinmux = < G32R5_PINMUX(224, 10) >;
	};
	/omit-if-no-ref/ qep1_a_gpio224: qep1_a_gpio224 {
		pinmux = < G32R5_PINMUX(224, 11) >;
	};
	/omit-if-no-ref/ uartc_tx_gpio224: uartc_tx_gpio224 {
		pinmux = < G32R5_PINMUX(224, 14) >;
	};
	/omit-if-no-ref/ lina_rx_gpio226: lina_rx_gpio226 {
		pinmux = < G32R5_PINMUX(226, 3) >;
	};
	/omit-if-no-ref/ pwm6_a_gpio226: pwm6_a_gpio226 {
		pinmux = < G32R5_PINMUX(226, 5) >;
	};
	/omit-if-no-ref/ spia_clk_gpio226: spia_clk_gpio226 {
		pinmux = < G32R5_PINMUX(226, 6) >;
	};
	/omit-if-no-ref/ pwm1_b_gpio226: pwm1_b_gpio226 {
		pinmux = < G32R5_PINMUX(226, 9) >;
	};
	/omit-if-no-ref/ qep1_strobe_gpio226: qep1_strobe_gpio226 {
		pinmux = < G32R5_PINMUX(226, 11) >;
	};
	/omit-if-no-ref/ uartc_rx_gpio226: uartc_rx_gpio226 {
		pinmux = < G32R5_PINMUX(226, 14) >;
	};
	/omit-if-no-ref/ i2cb_scl_gpio227: i2cb_scl_gpio227 {
		pinmux = < G32R5_PINMUX(227, 1) >;
	};
	/omit-if-no-ref/ pwm3_a_gpio227: pwm3_a_gpio227 {
		pinmux = < G32R5_PINMUX(227, 3) >;
	};
	/omit-if-no-ref/ outputxbar1_gpio227: outputxbar1_gpio227 {
		pinmux = < G32R5_PINMUX(227, 5) >;
	};
	/omit-if-no-ref/ pwm2_b_gpio227: pwm2_b_gpio227 {
		pinmux = < G32R5_PINMUX(227, 6) >;
	};
	/omit-if-no-ref/ adcsocao_gpio228: adcsocao_gpio228 {
		pinmux = < G32R5_PINMUX(228, 3) >;
	};
	/omit-if-no-ref/ cana_tx_gpio228: cana_tx_gpio228 {
		pinmux = < G32R5_PINMUX(228, 5) >;
	};
	/omit-if-no-ref/ spia_somi_gpio228: spia_somi_gpio228 {
		pinmux = < G32R5_PINMUX(228, 6) >;
	};
	/omit-if-no-ref/ pwm2_b_gpio228: pwm2_b_gpio228 {
		pinmux = < G32R5_PINMUX(228, 9) >;
	};
	/omit-if-no-ref/ qep1_b_gpio228: qep1_b_gpio228 {
		pinmux = < G32R5_PINMUX(228, 11) >;
	};
	/omit-if-no-ref/ i2cb_sda_gpio230: i2cb_sda_gpio230 {
		pinmux = < G32R5_PINMUX(230, 1) >;
	};
	/omit-if-no-ref/ pwm3_b_gpio230: pwm3_b_gpio230 {
		pinmux = < G32R5_PINMUX(230, 3) >;
	};
	/omit-if-no-ref/ cana_rx_gpio230: cana_rx_gpio230 {
		pinmux = < G32R5_PINMUX(230, 5) >;
	};
	/omit-if-no-ref/ pwm2_a_gpio230: pwm2_a_gpio230 {
		pinmux = < G32R5_PINMUX(230, 6) >;
	};
	/omit-if-no-ref/ i2ca_sda_gpio230: i2ca_sda_gpio230 {
		pinmux = < G32R5_PINMUX(230, 7) >;
	};
	/omit-if-no-ref/ pmbusa_scl_gpio230: pmbusa_scl_gpio230 {
		pinmux = < G32R5_PINMUX(230, 9) >;
	};
	/omit-if-no-ref/ outputxbar2_gpio242: outputxbar2_gpio242 {
		pinmux = < G32R5_PINMUX(242, 5) >;
	};
	/omit-if-no-ref/ spia_ste_gpio242: spia_ste_gpio242 {
		pinmux = < G32R5_PINMUX(242, 6) >;
	};
	/omit-if-no-ref/ pwm4_a_gpio242: pwm4_a_gpio242 {
		pinmux = < G32R5_PINMUX(242, 9) >;
	};
	/omit-if-no-ref/ cana_rx_gpio242: cana_rx_gpio242 {
		pinmux = < G32R5_PINMUX(242, 10) >;
	};
	/omit-if-no-ref/ qep1_index_gpio242: qep1_index_gpio242 {
		pinmux = < G32R5_PINMUX(242, 11) >;
	};
};
